#include <string.h>
#include <stdlib.h>
#include "driver/i2c.h"
#include "freertos/FreeRTOS.h"
#include "oled.h"

#define I2C_MASTER_NUM  I2C_NUM_0
#define OLED_ADDR       0x3C

/* ════════════════════════════════════════
   FONT 8×8  (Space 0x20 … Z 0x5A)
   ════════════════════════════════════════ */
static const uint8_t font8x8[][8] = {
    {0x00,0x00,0x00,0x00,0x00,0x00,0x00,0x00}, /* Space */
    {0x00,0x00,0x5F,0x00,0x00,0x00,0x00,0x00}, /* !     */
    {0x00,0x07,0x00,0x07,0x00,0x00,0x00,0x00}, /* "     */
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    {0x61,0x51,0x49,0x45,0x43,0x00,0x00,0x00}, /* Z     */
};

/* ── Lấy bitmap ký tự (hỗ trợ lowercase → uppercase) ── */
static const uint8_t *get_char_bitmap(char c)
{
    if (c >= 'a' && c <= 'z') c -= 32;
    if (c >= 0x20 && c <= 0x5A) return font8x8[(uint8_t)c - 0x20];
    return font8x8[0]; /* fallback: Space */
}

/* ════════════════════════════════════════
   LOW-LEVEL WRITE
   ════════════════════════════════════════ */
static void oled_cmd(uint8_t cmd)
{
    uint8_t buf[2] = {0x00, cmd};
    i2c_master_write_to_device(I2C_MASTER_NUM, OLED_ADDR,
                               buf, 2, pdMS_TO_TICKS(1000));
}

static void oled_data(const uint8_t *data, size_t len)
{
    uint8_t *buf = malloc(len + 1);
    if (!buf) return;
    buf[0] = 0x40;
    memcpy(&buf[1], data, len);
    i2c_master_write_to_device(I2C_MASTER_NUM, OLED_ADDR,
                               buf, len + 1, pdMS_TO_TICKS(1000));
    free(buf);
}

static void oled_set_cursor(uint8_t page, uint8_t col)
{
    oled_cmd(0xB0 + page);
    oled_cmd(0x00 | (col & 0x0F));
    oled_cmd(0x10 | ((col >> 4) & 0x0F));
}

/* ════════════════════════════════════════
   PUBLIC API
   ════════════════════════════════════════ */
void oled_init(void)
{
    oled_cmd(0xAE);           /* Display OFF              */
    oled_cmd(0x20); oled_cmd(0x00); /* Horizontal addressing */
    oled_cmd(0xB0);           /* Page start = 0           */
    oled_cmd(0xC8);           /* COM scan direction       */
    oled_cmd(0x00);           /* Lower column start       */
    oled_cmd(0x10);           /* Upper column start       */
    oled_cmd(0x40);           /* Display start line       */
    oled_cmd(0x81); oled_cmd(0xFF); /* Contrast max       */
    oled_cmd(0xA1);           /* Segment remap            */
    oled_cmd(0xA6);           /* Normal display           */
    oled_cmd(0xA8); oled_cmd(0x3F); /* Multiplex ratio   */
    oled_cmd(0xA4);           /* Entire display ON        */
    oled_cmd(0xD3); oled_cmd(0x00); /* Display offset     */
    oled_cmd(0xD5); oled_cmd(0xF0); /* Clock divide ratio */
    oled_cmd(0xD9); oled_cmd(0x22); /* Pre-charge period  */
    oled_cmd(0xDA); oled_cmd(0x12); /* COM pins config    */
    oled_cmd(0xDB); oled_cmd(0x20); /* VCOMH deselect     */
    oled_cmd(0x8D); oled_cmd(0x14); /* Charge pump ON     */
    oled_cmd(0xAF);           /* Display ON               */
}

void oled_clear(void)
{
    uint8_t zero[128] = {0};
    for (int i = 0; i < 8; i++) {
        oled_cmd(0xB0 + i);
        oled_cmd(0x00);
        oled_cmd(0x10);
        oled_data(zero, 128);
    }
}

void oled_print_line(uint8_t page, const char *str)
{
    int len = (int)strlen(str);
    for (int i = 0; i < len && i < 16; i++) {
        oled_set_cursor(page, (uint8_t)(i * 8));
        oled_data(get_char_bitmap(str[i]), 8);
    }
}